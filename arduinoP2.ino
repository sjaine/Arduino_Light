#include <Adafruit_GFX.h>
#include <Adafruit_SSD1306.h>
#include <Arduino_SensorKit.h>
#include <string.h>
#include <Wire.h>

#define OLED_RESET 4
Adafruit_SSD1306 display(OLED_RESET);

#define FRAME_DELAY (42)
#define FRAME_WIDTH (32)
#define FRAME_HEIGHT (32)
#define FRAME_COUNT (sizeof(frames) / sizeof(frames[0]))
const byte PROGMEM frames[][128] = {
  {0,0,0,0,0,0,0,0,0,0,0,0,0,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255,255},
  {0,0,0,0,0,0,0,0,0,0,0,0,0,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255,255},
  {0,0,0,0,0,0,0,0,0,0,0,0,0,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255,255},
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  {0,0,0,0,0,0,0,0,0,1,128,0,0,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255,255}
};

int light_sensor = A3; 
bool wasLightHigh = false; 

struct MessageValue {
  String message;
  String value;
};

void sendMessage(struct MessageValue message) { 
  Serial.print(message.message);
  Serial.print("||");
  Serial.print(message.value);
  Serial.println();
}

struct MessageValue getMessage(String inputtedStr) {
  struct MessageValue result;

  char charArr[50];
  inputtedStr.toCharArray(charArr, 50);
  char* ptr = strtok(charArr, "||");
  result.message = String(ptr);
  ptr = strtok(NULL, "||");

  if (ptr == NULL) {
    result.value = String("");
    return result;
  }
  result.value = String(ptr);
  return result;
}

void setup() {
  Serial.begin(9600); //this number needs to match the baud rate you select in ProtoPie Connect arduino plugin
  Serial.setTimeout(10); // Set waiting time for serial data to 10 milliSeconds
  display.begin(SSD1306_SWITCHCAPVCC, 0x3C);
  display.clearDisplay();

  if (!display.begin(SSD1306_SWITCHCAPVCC, 0x3C)) {
    Serial.println("SSD1306 allocation failed");
    while (true); 
  } else {
    Serial.println("Works");
  }
}

int frame = 0;

void loop() {
  struct MessageValue receivedData;

  while (Serial.available() > 0) { // Take out strings until Serial is empty
    String receivedString = Serial.readStringUntil('\0'); // From 1.9.0 version, We can use '\0' as delimiter in Arduino Serial
    receivedData = getMessage(receivedString);
  }

  // get the value of the light sensor
  int raw_light = analogRead(light_sensor);
  int light = map(raw_light, 0, 100, 0, 100);

  // send a message through ProtoPie Connect
  struct MessageValue brightness;
  brightness.message = "brightness";
  brightness.value = light;
  sendMessage(brightness);

  // if the level is more than 90, than animation will be start
  if (light >= 90) {
    wasLightHigh = true;
  } else if (light <= 10) {
    wasLightHigh = false; // if the level is lower than 10, the animation will be stopped
    frame = 0; 
  }

  // the code of animation 
  if(wasLightHigh) {
    display.clearDisplay(); 
    display.setRotation(1);
    display.drawBitmap(0, 50, frames[frame], FRAME_WIDTH, FRAME_HEIGHT, 1);
    display.display();
    frame = (frame + 1) % FRAME_COUNT;
  }
  
  delay(FRAME_DELAY);
}

